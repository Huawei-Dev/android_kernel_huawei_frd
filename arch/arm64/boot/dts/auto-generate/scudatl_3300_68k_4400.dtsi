/* DO NOT EDIT - Automatically generated by python */
/ {
		scudatl_3300_68k_4400:scudatl_3300_68k_4400 {
			fcc = <3300>;
			default_rbatt_mohm = <100>;
			id_identify_min = <1759>;
			id_identify_max = <2281>;
			id_voltage_min = <1956>;
			id_voltage_max = <2135>;
			vbat_max = <4400>;
			temp_para = 
						"-32767","0","-1","0","4100","0",
						"0","5","-1","330","4400","0",
						"5","10","-1","990","4400","3",
						"10","45","-1","-1","4400","3",
						"45","50","-1","1155","4400","3",
						"50","32767","-1","0","4400","0";
			vbat_para = 
						"-32767","3400","-1","820","0",
						"3400","32767","-1","-1","0";
			segment_para = 
						"-32767","4150","3300","4208","50",
						"4150","4450","2310","4400","0";
			batt_brand = "scudatl";
			fcc_temp = <3451 3449 3447 3463 3452 3428>;
			fcc_sf_x = <0 100 200 300 400 500>;
			fcc_sf_y = <100 96 94 92 90 88>;
			fcc_sf_cols = <6>;
			pc_sf_rows = <1>;
			pc_sf_cols = <1>;
			pc_sf_row_entries = <0>;
			pc_sf_percent = <100>;
			pc_sf_sf = <100>;
			rbatt_sf_rows = <28>;
			rbatt_sf_cols = <6>;
			rbatt_sf_percent = <100 95 90 85 80 75 70 65 60 55 50 45 40 35 30 25 20 15 10 9 8 7 6 5 4 3 2 1>;
			rbatt_sf_sf = <
			               1837 899 421 141 117 106
			               1836 899 421 141 117 106
			               1732 905 422 142 117 107
			               1633 902 420 145 119 108
			               1576 891 429 149 122 110
			               1542 937 451 155 125 112
			               1338 836 476 167 131 115
			               1330 778 415 182 138 119
			               1321 783 397 187 152 129
			               1314 771 378 150 128 113
			               1321 775 376 138 116 107
			               1360 819 373 139 116 109
			               1417 884 379 142 120 111
			               1475 957 407 145 124 114
			               1558 1047 443 145 125 116
			               1638 1162 497 143 116 107
			               1727 1296 561 139 115 106
			               1844 1449 643 142 116 107
			               1896 1384 621 140 115 109
			               1913 1384 549 139 115 108
			               1964 1553 582 141 117 110
			               2033 1759 632 142 117 110
			               2144 1990 704 143 119 111
			               2279 2269 786 143 119 108
			               2550 2560 879 143 118 109
			               2952 2955 1019 148 119 111
			               3550 3514 1279 164 124 112
			               4438 4492 1787 236 139 130
			              >;
			pc_temp_ocv_rows = <29>;
			pc_temp_ocv_cols = <6>;
			pc_temp_ocv_percent = <100 95 90 85 80 75 70 65 60 55 50 45 40 35 30 25 20 15 10 9 8 7 6 5 4 3 2 1>;
			pc_temp_ocv_ocv = <
			                   4385 4382 4379 4372 4367 4360
			                   4288 4302 4308 4312 4308 4302
			                   4217 4240 4249 4253 4249 4245
			                   4157 4182 4191 4195 4192 4187
			                   4108 4124 4137 4139 4136 4132
			                   4066 4085 4088 4085 4082 4079
			                   3965 4004 4033 4036 4034 4030
			                   3923 3938 3962 3986 3986 3985
			                   3887 3901 3919 3942 3944 3943
			                   3854 3861 3877 3889 3890 3888
			                   3826 3828 3844 3853 3854 3854
			                   3808 3809 3817 3828 3829 3828
			                   3794 3797 3797 3808 3809 3808
			                   3779 3787 3786 3791 3792 3791
			                   3767 3775 3776 3776 3776 3773
			                   3751 3763 3766 3762 3755 3743
			                   3736 3745 3750 3742 3734 3721
			                   3721 3720 3723 3715 3708 3695
			                   3701 3696 3693 3692 3684 3672
			                   3696 3691 3690 3690 3683 3671
			                   3690 3686 3687 3689 3682 3670
			                   3684 3682 3683 3686 3680 3668
			                   3673 3675 3678 3683 3676 3664
			                   3657 3661 3665 3670 3662 3647
			                   3628 3632 3634 3634 3626 3609
			                   3582 3586 3583 3582 3576 3559
			                   3515 3517 3513 3513 3508 3492
			                   3414 3416 3414 3414 3409 3392
			                   3200 3200 3200 3200 3200 3200
			                  >;
		};
};
