/* DO NOT EDIT - Automatically generated by python */
/ {
		sunwodalg_3300_200k_4400:sunwodalg_3300_200k_4400 {
			fcc = <3300>;
			default_rbatt_mohm = <100>;
			id_identify_min = <2786>;
			id_identify_max = <3312>;
			id_voltage_min = <2941>;
			id_voltage_max = <3167>;
			vbat_max = <4400>;
			temp_para = 
						"-32767","0","-1","0","4100","0",
						"0","5","-1","330","4400","0",
						"5","10","-1","990","4400","3",
						"10","45","-1","-1","4400","3",
						"45","50","-1","1155","4400","3",
						"50","32767","-1","0","4400","0";
			vbat_para = 
						"-32767","3400","-1","820","0",
						"3400","32767","-1","-1","0";
			segment_para = 
						"-32767","4150","3300","4208","50",
						"4150","4450","2310","4400","0";
			batt_brand = "sunwodalg";
			fcc_temp = <3514 3503 3498 3523 3502 3485>;
			fcc_sf_x = <0 100 200 300 400 500>;
			fcc_sf_y = <100 96 94 92 90 88>;
			fcc_sf_cols = <6>;
			pc_sf_rows = <1>;
			pc_sf_cols = <1>;
			pc_sf_row_entries = <0>;
			pc_sf_percent = <100>;
			pc_sf_sf = <100>;
			rbatt_sf_rows = <28>;
			rbatt_sf_cols = <6>;
			rbatt_sf_percent = <100 95 90 85 80 75 70 65 60 55 50 45 40 35 30 25 20 15 10 9 8 7 6 5 4 3 2 1>;
			rbatt_sf_sf = <
			               2104 1264 562 130 96 82
			               2096 1263 562 130 96 82
			               1960 1242 568 131 95 83
			               1854 1215 567 133 97 84
			               1812 1208 582 138 100 85
			               1707 1179 621 146 103 86
			               1580 1033 564 157 109 89
			               1573 1010 518 168 116 93
			               1562 999 506 170 126 100
			               1561 990 486 142 113 95
			               1583 1012 480 124 95 84
			               1639 1066 487 124 96 84
			               1713 1140 519 128 98 86
			               1822 1233 568 130 103 90
			               1936 1352 640 130 103 88
			               2040 1477 735 127 95 84
			               2125 1594 844 126 95 83
			               2231 1705 991 139 96 83
			               2588 2136 888 126 96 84
			               2605 2284 964 129 98 82
			               2766 2487 1040 131 96 82
			               3029 2682 1168 133 97 85
			               3196 2918 1305 137 97 86
			               3255 3154 1504 154 104 86
			               3080 3326 1661 258 111 163
			               2892 3483 1538 249 147 116
			               2629 3926 1888 258 169 88
			               2883 4397 2129 222 155 117
			              >;
			pc_temp_ocv_rows = <29>;
			pc_temp_ocv_cols = <6>;
			pc_temp_ocv_percent = <100 95 90 85 80 75 70 65 60 55 50 45 40 35 30 25 20 15 10 9 8 7 6 5 4 3 2 1>;
			pc_temp_ocv_ocv = <
			                   4385 4381 4378 4372 4364 4359
			                   4269 4278 4288 4304 4298 4294
			                   4192 4207 4224 4244 4238 4235
			                   4129 4147 4165 4187 4181 4178
			                   4083 4098 4114 4131 4126 4123
			                   4017 4044 4067 4081 4074 4071
			                   3941 3960 3997 4029 4026 4023
			                   3902 3916 3940 3976 3980 3979
			                   3865 3876 3899 3937 3938 3937
			                   3834 3840 3859 3887 3890 3890
			                   3811 3817 3828 3850 3850 3850
			                   3797 3803 3806 3825 3825 3824
			                   3785 3793 3793 3805 3805 3804
			                   3775 3783 3784 3789 3790 3788
			                   3763 3774 3776 3775 3774 3769
			                   3750 3761 3765 3762 3754 3743
			                   3736 3743 3747 3743 3735 3722
			                   3723 3721 3721 3719 3709 3695
			                   3701 3697 3693 3691 3683 3672
			                   3696 3693 3690 3689 3682 3670
			                   3692 3690 3686 3688 3681 3669
			                   3684 3686 3682 3685 3679 3667
			                   3675 3681 3674 3681 3674 3661
			                   3662 3670 3662 3667 3659 3642
			                   3634 3646 3643 3635 3624 3610
			                   3593 3598 3596 3588 3577 3560
			                   3526 3529 3534 3521 3513 3490
			                   3422 3413 3426 3414 3412 3390
			                   3200 3200 3200 3200 3200 3200
			                  >;
		};
};
