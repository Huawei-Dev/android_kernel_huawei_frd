/* DO NOT EDIT - Automatically generated by python */
/ {
		sunwodalg_3300_10k_4400:sunwodalg_3300_10k_4400 {
			fcc = <3300>;
			default_rbatt_mohm = <100>;
			id_identify_min = <0>;
			id_identify_max = <751>;
			id_voltage_min = <496>;
			id_voltage_max = <553>;
			vbat_max = <4400>;
			temp_para = 
						"-32767","0","-1","0","4100","0",
						"0","5","-1","330","4400","0",
						"5","10","-1","990","4400","3",
						"10","45","-1","-1","4400","3",
						"45","50","-1","1155","4400","3",
						"50","32767","-1","0","4400","0";
			vbat_para = 
						"-32767","3400","-1","820","0",
						"3400","32767","-1","-1","0";
			segment_para = 
						"-32767","4150","3300","4208","50",
						"4150","4450","2310","4400","0";
			batt_brand = "sunwodalg";
			fcc_temp = <3626 3627 3618 3691 3626 3605>;
			fcc_sf_x = <0 100 200 300 400 500>;
			fcc_sf_y = <100 96 94 92 90 88>;
			fcc_sf_cols = <6>;
			pc_sf_rows = <1>;
			pc_sf_cols = <1>;
			pc_sf_row_entries = <0>;
			pc_sf_percent = <100>;
			pc_sf_sf = <100>;
			rbatt_sf_rows = <28>;
			rbatt_sf_cols = <6>;
			rbatt_sf_percent = <100 95 90 85 80 75 70 65 60 55 50 45 40 35 30 25 20 15 10 9 8 7 6 5 4 3 2 1>;
			rbatt_sf_sf = <
			               1994 1403 632 139 97 82
			               1988 1401 633 139 97 82
			               1891 1354 636 138 97 82
			               1798 1309 636 140 99 84
			               1754 1277 642 143 101 85
			               1679 1235 678 151 105 87
			               1571 1104 617 161 110 90
			               1572 1090 559 175 117 94
			               1546 1078 555 170 124 100
			               1536 1056 541 139 110 94
			               1565 1065 533 127 95 83
			               1611 1108 542 126 96 84
			               1680 1170 573 130 98 86
			               1763 1252 628 133 103 90
			               1867 1356 640 133 104 88
			               1986 1470 637 131 95 83
			               2117 1582 729 129 95 82
			               2478 1666 838 125 96 82
			               4284 2219 873 130 94 83
			               4523 2376 928 131 96 84
			               4736 2539 994 134 96 85
			               5009 2708 1064 137 96 84
			               5297 2980 1165 139 97 84
			               5588 3195 1293 164 102 84
			               6081 3532 1520 310 212 127
			               6398 3726 1564 405 188 142
			               6607 3806 1516 439 163 107
			               7652 4680 1666 286 181 110
			              >;
			pc_temp_ocv_rows = <29>;
			pc_temp_ocv_cols = <6>;
			pc_temp_ocv_percent = <100 95 90 85 80 75 70 65 60 55 50 45 40 35 30 25 20 15 10 9 8 7 6 5 4 3 2 1>;
			pc_temp_ocv_ocv = <
			                   4389 4385 4381 4385 4366 4361
			                   4284 4288 4294 4321 4302 4297
			                   4210 4217 4227 4261 4243 4239
			                   4145 4155 4169 4203 4186 4182
			                   4092 4100 4116 4147 4130 4127
			                   4026 4044 4071 4095 4078 4074
			                   3948 3962 4002 4039 4029 4026
			                   3911 3921 3941 3988 3982 3981
			                   3869 3882 3902 3942 3939 3938
			                   3833 3844 3863 3891 3890 3891
			                   3812 3817 3831 3854 3851 3851
			                   3798 3802 3808 3828 3826 3826
			                   3786 3791 3794 3807 3806 3805
			                   3773 3779 3785 3790 3790 3788
			                   3762 3767 3774 3775 3773 3769
			                   3751 3754 3763 3760 3753 3742
			                   3738 3736 3747 3740 3734 3721
			                   3721 3720 3719 3714 3707 3694
			                   3693 3695 3696 3690 3682 3671
			                   3686 3691 3693 3688 3681 3670
			                   3678 3685 3690 3686 3680 3669
			                   3668 3676 3685 3683 3677 3666
			                   3655 3668 3677 3674 3672 3661
			                   3633 3650 3662 3649 3656 3642
			                   3613 3627 3640 3613 3625 3608
			                   3575 3585 3600 3569 3578 3561
			                   3499 3509 3531 3505 3510 3493
			                   3397 3406 3415 3388 3409 3393
			                   3200 3200 3200 3200 3200 3200
			                  >;
		};
};
