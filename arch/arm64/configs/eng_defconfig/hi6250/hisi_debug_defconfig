## arch/arm64/configs/eng_defconfig/hi6250/hisi_debug_defconfig
```kconfig
CONFIG_KPROBES=y
CONFIG_HAVE_KPROBES=y
CONFIG_KRETPROBES=y
CONFIG_HAVE_KRETPROBES=y
CONFIG_HISI_PAGE_TRACKER=y
```

## drivers/clk/hisi/peri_dvfs/Kconfig
```kconfig
config HISI_PERIDVFS
	bool "hi3660 Soc"
	default n
config HISI_PERI_FAST_AVS
	depends on HISI_PERIDVFS
	depends on HISI_MAILBOX
	bool "hi3660 Soc"
	default n
```

## drivers/connectivity/Kconfig
```kconfig
#
# Generic huawei hisi misc drivers configuration
#
source "drivers/connectivity/hisi/Kconfig"
```

## drivers/connectivity/hisi/Kconfig
```kconfig
#
# Generic huawei hisi misc drivers configuration
#
menuconfig CONNECTIVITY_HI110X
	bool "Hisilicon Wireless Connectivity Support"
	---help---
		If you want to use Hisilicon  Wireless Connectivity, you should set this,
		and choose one product

if CONNECTIVITY_HI110X

if ARCH_HI6250
config HISI_GPS_REF_CLK
       bool "hisi_gnss_refclk"
       default y
endif

if ARCH_HI3650
config HISI_GPS_REF_CLK
       bool "hisi_gnss_refclk"
       default y
endif

config HI110X_SDIO_STD_CARD_SUPPORT
        bool
        default y

config HI110X_SDIO_FPGA
        bool
        default y

config HI110X_SDIO_NON_STD_CARD_SUPPORT
        bool
        default y
        depends on !HI110X_SDIO_STD_CARD_SUPPORT

config HI110X_SDIO_DETECT_FUNCTION
        bool
        default y

config HI1102_PLAT_HW_CHR
  bool "Hisilicon 1102 platform chr log"
  default y
  ---help---
        Hisilicon 1102 platform chr log

config HI110X_DRIVER_PATH
	string "The Kernel Driver Path"
	default "drivers/connectivity/hisi"

config HI1102_WIFI
        tristate "Hisilicon Wireless Connectivity WiFi Module"
        depends on WIRELESS && CFG80211
        select WIRELESS_EXT
        select WEXT_SPY
        select WEXT_PRIV
        default y
        ---help---
                If you want to use Hisilicon  Wireless Connectivity,first choose this.

endif
```

## drivers/contexthub/Kconfig
```kconfig
config CONTEXTHUB
	bool "Sensor CONTEXTHUB driver"
	default n
	help
	Sensor CONTEXTHUB driver.
config CONTEXTHUB_SHMEM
	bool "Sensor CONTEXTHUB SHMEM driver"
	depends on CONTEXTHUB
	default n
	help
	Say yes here if you want to configure contexthub share memory
```

## drivers/cpufreq/hisi/Kconfig.arm
```kconfig
config ARCH_HISI_MAXFREQ
	bool "Hisilicon platform cpu max freq recognition"
	depends on PM_OPP
	default n
	help
	  Hisilicon platform cpu max freq recognition.
config HISI_ENABLE_GET_VAL
  bool "Hisilicon get cpufreq param"
  default n
  help
    Hisilicon get cpufreq param.
```

## drivers/hisi/efuse/Kconfig
```kconfig
config HI3XXX_EFUSE
	bool "Support Hisilicon Hi3XXX efuse"
    depends on ATFDRIVER
	default n
	help
	Hi3XXX efuse driver support
```

## drivers/hisi/hi3xxx/Kconfig
```kconfig
config HISILICON_PLATFORM_HI3XXX
	bool "HISILICON PLATFORM HI3XXX"
	default n

if HISILICON_PLATFORM_HI3XXX

config HISI_REBOOT_TYPE
	bool "Hisilicon hi3xxx reboot type driver"
	depends on HI3XXX_POWER_OFF
	default n
	help
	  Reboot type support for the Hisilicon HI3xxx boards

config HISI_LPM3_DEBUG
	depends on HISI_MAILBOX
	bool "Hisilicon LPM3 debug"
	default n
	help
	  Hi3xxx lpm3 debug driver

config HISI_HISEE
	depends on HISI_MAILBOX
	bool "Hisilicon hisee "
	default n
	help
	  Hi3xxx hisee driver

config HI3XXX_MODEM_ETB
	bool "hisi modem etb driver"
	default n
	help
	  enable etb trace for modem for hisi platform

config HISI_BOOST5V_CONTROL
	bool "support boost5v control function"
	default n
	help
	  Say 'Y' here if you want to support boost5v control enable.
endif
```

## drivers/hisi/isp/Kconfig
```kconfig
config HI3XXX_ISP
	bool "Support Hisilicon Hi3XXX isp"
    depends on ATFDRIVER
	default n
	help
	Hi3660 isp driver support
```

## drivers/hisi/modem/drv/easy_shell/Kconfig
```kconfig
#
# Balong easy shell configuration
#
config BALONG_EASY_SHELL
	bool "balong easy shell(ecall) support"
	default n
	help
		Support for the Hisilicon Balong easy shell.
```

## drivers/huawei_platform/audio/hifi_vir_dai/Kconfig
```kconfig
config HIFI_VIR_DAI
    tristate "HIFI_VIR_DAI Driver for extern hifi"
	default n
	help
		Say Y to enable HIFI_VIR_DAI Driver Support For extern hifi
```

## drivers/huawei_platform/net/ipv4/Kconfig
```kconfig
config HW_WIFIPRO
	bool "Huawei wifipro tcp monitor support"
	default n

config HW_WIFIPRO_PROC
	bool "Huawei wifipro proc support"
	depends on HW_WIFIPRO
	default n

config HW_WIFI
	bool "Huawei wifi tcp monitor support"
	default n

config HUAWEI_MSS_AUTO_CHANGE
        bool "Huawei MSS auto change function support"
        default n
```

## drivers/huawei_platform/power/hw_ptm/Kconfig
```kconfig
config HW_PTM
    boolean "Huawei Power Thermal Monitor"
    default n
    help
        Huawei PTM, please choose it.
```

## drivers/huawei_platform/usb/pd/Kconfig
```kconfig
config TCPC_USB_CB_HISI
	bool "TCPC HISI USB callback driver"
	depends on TCPC_CLASS
	default n
	help
	  Say Y to enable

config RT_REGMAP
        bool "Richtek Regmap"
        select DEBUG_FS
        default n
        help
          Say Y to enable Richtek Register Map

source "drivers/huawei_platform/usb/pd/richtek/Kconfig"
```

## drivers/huawei_platform/usb/pd/richtek/Kconfig
```kconfig
config TCPC_CLASS
	bool "TypeC Port Controller Device Class"
	help
	  Say Y to enable Typec Port Controller Device Class

config USB_POWER_DELIVERY
	bool "Support USB power delivery Function"
	default n
	help
	  Say Y to enable USB Power Delivery support

config TCPC_RT1711
	bool "Richtek RT1711 TypeC port Controller Driver"
	depends on TCPC_CLASS
	default n
	help
	  Say Y to enable Richtek RT1711 TypeC port Controller Driver

config TCPC_RT1711H
	bool "Richtek RT1711H TypeC port Controller Driver"
	depends on TCPC_CLASS
	default n
	help
	  Say Y to enable Richtek RT1711H TypeC port Controller Driver
```

## drivers/media/huawei/camera/platform/hi3660/Kconfig
```kconfig
comment "Huawei Sensor"

source "drivers/media/huawei/camera/sensor/vcm/Kconfig"
source "drivers/media/huawei/camera/sensor/flash/Kconfig"
source "drivers/media/huawei/camera/sensor/ois/Kconfig"

config HUAWEI_CAMERA_USE_IMX230
	bool "imx230"
    default y
	depends on HUAWEI_CAMERA

config HUAWEI_CAMERA_USE_IMX298
	bool "imx298"
    default y
	depends on HUAWEI_CAMERA

config HUAWEI_CAMERA_USE_IMX179
	bool "imx179"
    default y
	depends on HUAWEI_CAMERA
```
